## main/Kconfig.projbuild
```kconfig
menu "AMBE3000 compat firmware (USB, plain mbelib-neo)"

    config AMBE_UART_NUM
        int "UART number"
        default 0
        help
            UART0 is the one wired to the USB-UART bridge (CH340/CP2102) on ESP32 DevKits. The ESP-IDF console is
            disabled (sdkconfig.defaults.esp32) so nothing but the DV3000 protocol is sent on it.

    config AMBE_UART_BAUD
        int "UART baud rate"
        default 460800
        help
            460800 is the DV3000 / ThumbDV rate that BlueDV and AMBEServer use.

    config AMBE_UART_TX_PIN
        int "UART TX pin (-1 = default pin of that UART)"
        default -1

    config AMBE_UART_RX_PIN
        int "UART RX pin (-1 = default pin of that UART)"
        default -1

endmenu
```

## sdkconfig.defaults
```kconfig
# Common
CONFIG_ESPTOOLPY_FLASHSIZE_4MB=y
CONFIG_PARTITION_TABLE_CUSTOM=y
CONFIG_PARTITION_TABLE_CUSTOM_FILENAME="partitions.csv"
CONFIG_COMPILER_OPTIMIZATION_PERF=y
CONFIG_ESP_DEFAULT_CPU_FREQ_MHZ_240=y
CONFIG_FREERTOS_HZ=1000
```

## sdkconfig.defaults.esp32
```kconfig
CONFIG_AMBE_TRANSPORT_UART=y
CONFIG_ESP_CONSOLE_NONE=y
CONFIG_BOOTLOADER_LOG_LEVEL_NONE=y
CONFIG_ESP_SYSTEM_PANIC_PRINT_REBOOT=y
CONFIG_AMBE_BENCH_LOG=n
```

## sdkconfig.defaults.esp32s3
```kconfig
CONFIG_AMBE_TRANSPORT_USB_CDC=y
CONFIG_ESP_CONSOLE_UART_DEFAULT=y
CONFIG_TINYUSB_CDC_COUNT=1
CONFIG_TINYUSB_CDC_RX_BUFSIZE=512
CONFIG_TINYUSB_CDC_TX_BUFSIZE=512
```
